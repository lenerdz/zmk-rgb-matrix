## Kconfig
```kconfig
config LED_STRIP_COMPOSITE
    bool "Composite RGB LED strip"
    default y
    depends on DT_HAS_ZMK_LED_STRIP_COMPOSITE_ENABLED
    select LED_STRIP
    help
      Concatenates the devices referenced by a zmk,led-strip-composite node
      into one RGB LED strip. Available independently of the RGB matrix.

config LED_STRIP_COMPOSITE_INIT_PRIORITY
    int "Composite LED strip initialization priority"
    default 91
    range 0 99
    depends on LED_STRIP_COMPOSITE
    help
      POST_KERNEL-level initialization priority. Child devices must initialize
      earlier and consumers later. Nested composites at the same priority are
      ordered by devicetree dependencies on Zephyr 4.1.

config KEYPAW_RGB_MATRIX
    bool "Keypaw position-aware RGB matrix"
    default y
    depends on DT_HAS_KEYPAW_RGB_MATRIX_ENABLED
    select LED_STRIP
    help
      Drives an RGB LED strip with per-key, position-aware effects. The LED
      geometry (leds/mapping) comes from the keypaw,rgb-matrix devicetree
      node and the strip itself from its "strip" phandle.

if KEYPAW_RGB_MATRIX

config KEYPAW_RGB_WORKQUEUE_STACK_SIZE
    int "RGB matrix work queue stack size"
    default 2048
    range 1024 8192
    help
      Stack for the module's dedicated low-priority work queue, which runs all
      engine work: render passes, condition and trigger evaluation, split sync
      and the settings reset. Size it for the deepest chain, not just rendering:
      a fired trigger invokes an effect behavior, which on the split central
      reaches the BLE transport. Keep it above the observed high-water mark with
      margin.

config KEYPAW_RGB_WORKQUEUE_PRIORITY
    int "RGB matrix work queue thread priority"
    default 10
    help
      Priority of the module's work queue thread. The default matches ZMK's
      low-priority work queue so RGB work never preempts typing.

config KEYPAW_RGB_CONTROL_AUTO_START
    bool "Start RGB control automatically after source/settings initialization"
    default y
    help
      With settings enabled, start from a commit callback at priority INT_MAX,
      after all source commits at lower priorities and all settings keys load.
      Without settings, start at APPLICATION priority 99; the matrix application
      init priority must be lower. Providers must be ready at this boundary.
      Disable this if sources become ready later or settings are loaded in
      subtrees; call zmk_rgb_matrix_start() explicitly after full restoration.

config KEYPAW_RGB_MATRIX_TICK_MS
    int "Animation tick period (ms)"
    default 32
    range 1 1000
    help
      Upstream underglow uses 50 ms; 32 ms is noticeably smoother for the
      reactive and ripple effects. One update costs ~1.5 ms of blocking SPI.

config KEYPAW_RGB_MATRIX_HUE_STEP
    int "Hue adjustment step"
    default 10

config KEYPAW_RGB_MATRIX_SAT_STEP
    int "Saturation adjustment step"
    default 10

config KEYPAW_RGB_MATRIX_BRT_STEP
    int "Brightness adjustment step"
    default 10

config KEYPAW_RGB_MATRIX_DURATION_STEP
    int "Duration adjustment step (ms)"
    default 100
    help
      Animation "speed" is expressed as a period: a shorter duration animates
      faster. This is added to (or subtracted from) the active effect's period
      by the Duration Up/Down commands. An additive step is used because the
      relative press is resolved to an absolute value on the split central, and
      adding is exact regardless of the current period.

config KEYPAW_RGB_MATRIX_DURATION_MIN_MS
    int "Fastest animation period (ms)"
    default 100
    range 1 60000

config KEYPAW_RGB_MATRIX_DURATION_MAX_MS
    int "Slowest animation period (ms)"
    default 10000
    range 1 60000


config KEYPAW_RGB_MATRIX_AUTO_OFF_IDLE
    bool "Turn the matrix off when the keyboard goes idle"
    default y
    help
      Without this the strip might latch at its last color through deep sleep
      and keeps drawing current.

# Caps Lock will pull in a HID-indicator event dependency. Disable it if you
# don't need that.
config KEYPAW_RGB_CONDITION_CAPS_LOCK
    bool
    default y
    depends on DT_HAS_KEYPAW_RGB_CONDITION_CAPS_LOCK_ENABLED
    select ZMK_HID_INDICATORS
    help
      Caps Lock condition. Enabled by the presence of a
      keypaw,rgb-condition-caps-lock node. Selects ZMK_HID_INDICATORS, which is
      what the host sets when Caps Lock is on.

# BLE host-profile state exists only on the central, so the condition reads it
# there and returns false on a peripheral.
config KEYPAW_RGB_CONDITION_BLE
    bool
    default y
    depends on DT_HAS_KEYPAW_RGB_CONDITION_BLE_ENABLED
    help
      Bluetooth profile condition. Enabled by the presence of a
      keypaw,rgb-condition-ble node. Matches the active profile index and
      connection state; a build without Bluetooth compiles the condition to a
      constant false.

endif # KEYPAW_RGB_MATRIX

config KEYPAW_BEHAVIOR_RGB_MATRIX
    bool "RGB matrix control behavior"
    default y
    depends on DT_HAS_KEYPAW_BEHAVIOR_RGB_MATRIX_ENABLED
    select KEYPAW_RGB_MATRIX

config KEYPAW_RGB_MATRIX_CHANGE_EVENT
    bool "Raise zmk_rgb_matrix_changed when the user changes the lights"
    default y
    depends on KEYPAW_BEHAVIOR_RGB_MATRIX
    help
      Raises the zmk_rgb_matrix_changed event (zmk/events/rgb_matrix_changed.h)
      on the half that applies a &kprgb or &fx_* command that changed the active
      effect, the on/off intent, the brightness, the hue, the saturation or the
      speed, or that reset the state. A split keyboard raises it on both halves
      because the commands are global, so a peripheral's screen can show what
      changed (the zmk-nice-oled toast widget does).

      It is not raised for the state pushed to a peripheral when it connects, for
      ZMK Studio colour-map edits, or at boot. Costs one small event per command
      and nothing when no listener subscribes.

config KEYPAW_RGB_TRIGGERS
    bool "RGB matrix trigger table"
    default y
    depends on KEYPAW_BEHAVIOR_RGB_MATRIX
    depends on !ZMK_SPLIT || ZMK_SPLIT_ROLE_CENTRAL
    help
      Edge-triggered condition -> RGB command rules, declared as the children of
      a keypaw,rgb-trigger-table node (their declaration order is the firing
      order). Each rule runs its `on-enter` when its condition becomes active and
      its `on-exit` when it clears; rules are independent, so none shadows
      another. Each trigger references a reusable keypaw,rgb-condition-* node.

      Built for the split central only: a trigger's condition may read keymap
      state, which does not exist on a peripheral. The commands still reach both
      halves because the behavior is BEHAVIOR_LOCALITY_GLOBAL.

config KEYPAW_RGB_SPLIT_SYNC
    bool "Push the RGB state to a split peripheral when it connects"
    default y
    depends on KEYPAW_BEHAVIOR_RGB_MATRIX
    depends on ZMK_SPLIT && ZMK_SPLIT_ROLE_CENTRAL
    help
      A &kprgb command is BEHAVIOR_LOCALITY_GLOBAL, so it is forwarded to the
      peripheral and persisted there. A peripheral that was powered off while
      the settings changed therefore keeps stale flash defaults and reloads them
      on the next power-up. This pushes the selected effect, its colour and
      period, and the user on/off intent to a peripheral whenever it newly
      connects; the peripheral's own command handler applies and persists them.

      The forward of a switch carries only the effect index, so the peripheral
      would apply the new effect with its own colour and period. This also
      re-pushes the full snapshot when the active effect changes to one the
      peripheral has not received, keeping only the marker of the last effect
      pushed, so effects never selected on the central are still not synced.

      Built for the split central only. The trigger polls the transport's in-RAM
      connected-source list, which transmits nothing until a peripheral appears.

if KEYPAW_RGB_SPLIT_SYNC

config KEYPAW_RGB_SPLIT_SYNC_POLL_MS
    int "Peripheral connection poll period (ms)"
    default 1000
    range 1 60000
    help
      How often the connected-source set is sampled. The sample is an in-RAM
      array read with no radio traffic, and a peripheral reboot cannot finish
      inside one period, so a disconnect is always observed before the
      reconnect that follows it. Raise this to save one wakeup per period.

config KEYPAW_RGB_SPLIT_SYNC_SETTLE_MS
    int "Delay before pushing to a newly connected peripheral (ms)"
    default 1000
    range 1 60000
    help
      A peripheral is marked connected before its GATT characteristics have been
      discovered, and the split worker drops a command sent in that window with
      "Run behavior handle not found" without reporting it back to the sender.
      Waiting this long after the connection is seen gives discovery and the
      security upgrade time to finish. Best effort, not a guarantee.

config KEYPAW_RGB_SPLIT_SYNC_CLOCK_MS
    int "Shared animation clock re-sync period (ms)"
    default 30000
    range 1000 60000
    help
      How often the central re-sends its monotonic uptime so a peripheral
      corrects crystal drift in its shared animation-clock offset. Runs
      independently of the connection poll; an early drop self-heals on the
      next period.

endif # KEYPAW_RGB_SPLIT_SYNC

config KEYPAW_RGB_MAPS_STUDIO
    bool "Edit the colour maps from ZMK Studio"
    default y
    depends on KEYPAW_BEHAVIOR_RGB_MATRIX
    depends on ZMK_STUDIO_RPC
    help
      Adds the requests of the zmk-studio-messages fork (lenerdz/zmk-studio-messages)
      that read, edit, save, discard and restore the colour maps: the `static`
      effect instances that declare `layer-id`. Every request needs the keyboard
      to be unlocked, like the keymap ones. Also registers the maps with ZMK
      Studio's "restore stock settings".

      Needs the protocol of that fork: the stock zmk-studio-messages has no such
      requests, so building against it fails.

      Also needs CONFIG_ZMK_STUDIO_RPC_RX_BUF_SIZE=256 or more on the central half:
      ZMK Studio drops the bytes that do not fit its receive buffer (30 bytes by
      default), and a request that edits 16 colours is 158 bytes once framed. The
      build fails when the buffer is smaller.

      Without ZMK Studio on the build (the peripheral half, or ZMK_STUDIO off)
      this option is off, and the maps can still be set in devicetree and edited
      by whatever else calls the C API of rgb_maps.h.

config KEYPAW_DISPLAY_SETTINGS
    bool "Display (OLED) settings: contrast, screen off, toast"
    default n
    depends on KEYPAW_BEHAVIOR_RGB_MATRIX
    depends on ZMK_DISPLAY
    depends on !ZMK_DISPLAY_BLANK_ON_IDLE
    help
      A short list of numbered integer settings for the screens: the contrast of
      each half, when the screen goes off (never, only on battery, always) and
      after how many seconds, and the light toast of the zmk-nice-oled shield
      (on or off, how long). Each half applies them at once and keeps them in its
      own flash; the central pushes them to its peripheral with the same split
      sync that carries the colour maps, and ZMK Studio edits them through the
      display requests of lenerdz/zmk-studio-messages (see
      KEYPAW_DISPLAY_SETTINGS_STUDIO).

      The module blanks the screen by itself, so ZMK's own blanking
      (ZMK_DISPLAY_BLANK_ON_IDLE) has to be off: it cannot tell USB from battery,
      and it would turn the screen off whatever the setting says. The setting
      "never" is the behavior of that option being off.

      The commands that reach the peripheral travel in the RGB behavior (&kprgb),
      so this needs KEYPAW_BEHAVIOR_RGB_MATRIX, and it has to be on in the build of
      both halves.

config KEYPAW_DISPLAY_TOAST_MS_DEFAULT
    int "Default time the light toast stays on screen (ms)"
    default 1500
    range 500 5000
    depends on KEYPAW_DISPLAY_SETTINGS
    help
      The default of the display setting "toast duration", which ZMK Studio can
      change. 500 to 5000, the range of that setting.

config KEYPAW_DISPLAY_SAVE_DEBOUNCE_MS
    int "Delay before a changed display setting is written to flash (ms)"
    default 3000
    range 100 60000
    depends on KEYPAW_DISPLAY_SETTINGS
    help
      A change is applied at once. The write to flash waits this long after the
      last change, so dragging a slider in ZMK Studio writes once. ZMK's own
      CONFIG_ZMK_SETTINGS_SAVE_DEBOUNCE (60 s by default) is too long here: turning
      the keyboard off within that time would lose the change.

config KEYPAW_OLED_LAYOUT
    bool "OLED layout: which widgets the screens draw, and where"
    default n
    depends on KEYPAW_DISPLAY_SETTINGS
    depends on NICE_OLED_ON
    depends on NICE_OLED_WIDGET_STATUS
    help
      Adds to the display settings the layout of the zmk-nice-oled screens: for
      each widget, whether it is drawn and where (x and y on its canvas), and,
      on the right screen, which animation or image is shown and how long one
      cycle takes. ZMK Studio edits them like the other display settings (the
      ids 16 and up, include/zmk/display_settings.h); the central pushes the
      ones of the right screen to its peripheral, and each half keeps them in its
      own flash.

      The defaults are what the build says, so the screens look as they did
      without this option until something is changed: the positions come from
      the CONFIG_NICE_OLED_WIDGET_*_CUSTOM_X and _Y options, and the animation
      from CONFIG_NICE_OLED_WIDGET_ANIMATION_PERIPHERAL_*. Set the options of the
      right screen in the configuration of both halves: the central needs them
      for the defaults it lists and compares, the peripheral for its own.

      Needs the fork of zmk-nice-oled that reads these settings
      (lenerdz/zmk-nice-oled): the widgets draw again when the event
      zmk_display_settings_changed (zmk/events/display_settings_changed.h) is
      raised. With another zmk-nice-oled the settings are kept and synced but
      change nothing on the screens. Has to be on in the build of both halves.
      For the OLED screens (the nice_oled shield), not for the e-paper ones.

config KEYPAW_DISPLAY_SETTINGS_STUDIO
    bool "Edit the display settings from ZMK Studio"
    default y
    depends on KEYPAW_DISPLAY_SETTINGS
    depends on ZMK_STUDIO_RPC
    help
      Adds the display requests of the zmk-studio-messages fork
      (lenerdz/zmk-studio-messages): list the settings, change one, restore the
      defaults. A change is applied and kept at once, with no save step. Every
      request needs the keyboard to be unlocked, like the keymap ones. Also
      registers the settings with ZMK Studio's "restore stock settings".

      Needs the protocol of that fork: the stock zmk-studio-messages has no such
      requests, so building against it fails.

      Without ZMK Studio on the build (the peripheral half, or ZMK_STUDIO off)
      this option is off, and the settings are still applied, kept and received
      from the central.
```
