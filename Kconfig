## dts/bindings/keypaw,rgb-matrix-static.yaml
```yaml
# Copyright (c) 2026 The ZMK Contributors
# SPDX-License-Identifier: MIT

description: |
  Static per-LED colour map: each LED is painted with a fixed colour. A superset
  of QMK's ALPHAS_MODS (just assign different colours to alpha vs modifier keys)
  and any other fixed per-key art.

  The colours come from one of two lists:

    - `slot-colors`, indexed by colour slot (see "slot-count" and "no-key-slots"
      in keypaw,rgb-matrix). The same list serves both halves of a split
      keyboard, and with `layer-id` the map can be edited at run time.
    - `led-colors`, indexed by LED chain index. Used only when `slot-colors` is
      absent; the list is specific to one half.
compatible: "keypaw,rgb-matrix-static"
include: [zero_param.yaml, "keypaw,rgb-matrix-effect-common.yaml"]

properties:
  led-colors:
    type: array
    required: false
    default: [ ]
    description: |
      List of 24-bit RGB values, one per LED, indexed by the LED's position in
      the strip chain (0 = first LED). LEDs beyond the list length are left off.
      The list length must not exceed the number of LEDs. Ignored when
      `slot-colors` is present.

  slot-colors:
    type: array
    required: false
    description: |
      List of 24-bit RGB values, one per colour slot (0 = the first slot).
      Slots beyond the list length are off, and the list must not be longer than
      the "slot-count" of the keypaw,rgb-matrix node, which must be set. Each LED
      is painted with the colour of its own slot, and an LED whose slot is not in
      the list stays off. These are also the defaults an edited map returns to.

  layer-id:
    type: int
    required: false
    description: |
      Makes this map editable at run time: the id of the keymap layer the map
      belongs to, from 0 to 14. It is the stable layer id (`Layer.id` in the ZMK
      Studio protocol), not the position in the layer list, so the map follows its
      layer when the layers are reordered. Needs `slot-colors`. Two maps must not
      declare the same id.
```

## dts/bindings/keypaw,rgb-matrix.yaml
```yaml
# Copyright (c) 2026 The ZMK Contributors
# SPDX-License-Identifier: MIT

description: |
  Position-aware RGB LED matrix.

  Every LED carries an (x, y) position in the same units as the
  zmk,physical-layout (keypaw48: 100 = one key width) plus the key position it
  sits under. That is what lets effects use real geometry instead of treating
  the strip as an unnamed line.

compatible: "keypaw,rgb-matrix"

properties:
  label:
    type: string
    required: false
    deprecated: true
    description: Ignored; declared only because Zephyr 4.1 rejects undeclared properties.

  strip:
    type: phandle
    required: false
    description: |
      The physical or composite LED strip device driving this half's LEDs.
      Omit it when the half has no local LEDs (a USB-dongle central): nothing
      is rendered and "mapping" must then be empty. When present, its
      chain-length is the single source of truth for the LED count and the
      "mapping" length must agree with it.

  physical-layout:
    type: phandle
    required: true
    description: |
      The zmk,physical-layout node whose key attributes are used to place every
      per-key LED. A "mapping" entry that is a plain integer is treated as a key
      position into this layout; the LED's (x, y) centre is computed from the
      key's (x, y, width, height). LEDs not under a key use KP_RGB_NO_KEY(x, y)
      in the "mapping" instead.

  mapping:
    type: array
    required: true
    description: |
      Flat array, one entry per LED, in WS2812 chain order. Each entry is
      either a global key position (0..N-1) whose keycap sits above the LED --
      its centre is derived from "physical-layout" -- or KP_RGB_NO_KEY(x, y)
      for an LED not under a key (an edge/underglow LED) carrying explicit (x,
      y) coordinates in physical-layout units (100 = one key width). Length
      must equal the chain-length of "strip", and is empty when "strip" is
      omitted.

  slot-count:
    type: int
    required: false
    description: |
      Size of the color slot space, the same on every half of a split keyboard.
      A slot holds one color of a keypaw,rgb-matrix-static map. The slot of an
      LED under a key is that key's position, so this must be at least the number
      of keys of "physical-layout"; the slots above the keys belong to the LEDs
      that are not under a key (see "no-key-slots"), including those of the other
      half. Because a slot means the same thing on both halves, one list of
      "slot-colors" is valid for both, and an edit made on the central can be
      sent to the peripheral by slot. At most 60.

      Omit it to leave the slot model off: the static effect then reads
      "led-colors" by LED chain index, as before.

  no-key-slots:
    type: array
    required: false
    description: |
      One slot for each LED of this half that is not under a key (a
      KP_RGB_NO_KEY "mapping" entry), in the order those entries appear in
      "mapping". The slots of the other half's no-key LEDs are left out; a slot
      that no local LED paints is a slot that belongs to the peer.
```
